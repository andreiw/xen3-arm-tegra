## xen/arch/arm/Kconfig
```kconfig
mainmenu "Xen-on-ARM configuration"

config ARM
	bool
	default y

menu "General Setup"
config OPTIMIZE_FOR_SIZE
	bool "Optimize for size"
config USE_HIGH_VECTORS
	bool "Use high vectors table"
endmenu

menu "System Type"

config NOT_USE_WFI
	bool

config CPU_TLB_V7
	bool

config CPU_CACHE_V6
	bool

config CPU_COPYPAGE_V6
	bool

config CPU_ARMV7
	bool
	select CPU_TLB_V7
	select CPU_CACHE_V7
	select CPU_COPYPAGE_V6

config CPU_CORTEX_A9
       bool
       select CPU_ARMV7

config MACHINE_TEGRA2
       bool
       select CPU_CORTEX_A9

source "arch/arm/arch-tegra/Kconfig"

choice
	prompt "ARM platform"
config SELECT_PLATFORM_XOOM_TEGRA2
	bool "Xoom Tegra2"
	select PLATFORM_XOOM_TEGRA2
	help
		Say Y here if you are using the Tegra2 Xoom
endchoice
endmenu

menu "Customize Memory Map"

        menu "Domain Memory Size"
        config MEMMAP_GUEST_0_SIZE
                hex "domain0 memory size (including xen memory size : 2MB)"
                default 0x02000000

        config MEMMAP_GUEST_1_SIZE
                hex "domain1 memory size"
                default 0x01000000

        config MEMMAP_GUEST_2_SIZE
                hex "domain2 memory size"
                default 0x01000000

        config MEMMAP_GUEST_3_SIZE
                hex "domain3 memory size"
                default 0x00000000
        endmenu

        menu "Image Max Size"
        config MEMMAP_GUEST_0_ELF_MAX_SIZE
                hex "domain0 image max size"
                default 0x00400000

        config MEMMAP_GUEST_1_ELF_MAX_SIZE
                hex "domain1 image max size"
                default 0x00400000

        config MEMMAP_GUEST_2_ELF_MAX_SIZE
                hex "domain2 image max size"
                default 0x00400000

        config MEMMAP_GUEST_3_ELF_MAX_SIZE
                hex "domain3 image max size"
                default 0x00400000
        endmenu

        menu "Ram Disk Size"
        config MEMMAP_GUEST_0_RAMDISK_SIZE
                hex "domain0 ramdisk size"
                default 0x00400000

        config MEMMAP_GUEST_1_RAMDISK_SIZE
                hex "domain1 ramdisk size"
                default 0x00400000

        config MEMMAP_GUEST_2_RAMDISK_SIZE
                hex "domain2 ramdisk size"
                default 0x00400000

        config MEMMAP_GUEST_3_RAMDISK_SIZE
                hex "domain3 ramdisk size"
                default 0x00400000
        endmenu
endmenu

source "security/Kconfig"

source "common/Kconfig"
```

## xen/arch/arm/arch-tegra/Kconfig
```kconfig
config MACHINE_TEGRA2
	bool
	select CPU_CORTEX_A9
	select PIC_GIC

config TEGRA_FIQDB_SUPPORT
	depends on MACHINE_TEGRA2
	select FIQDB_SUPPORT
	bool "Enable Tegra FIQ debugger support"

choice
	depends on MACHINE_TEGRA2
	default TEGRA_DEBUG_UARTB if PLATFORM_XOOM_TEGRA2
	default TEGRA_DEBUG_UART_NONE
	prompt "Low-level debug console UART"

config TEGRA_DEBUG_UART_NONE
	bool "None"

config TEGRA_DEBUG_UARTA
	bool "UART-A"

config TEGRA_DEBUG_UARTB
	bool "UART-B"

config TEGRA_DEBUG_UARTC
	bool "UART-C"

config TEGRA_DEBUG_UARTD
	bool "UART-D"

config TEGRA_DEBUG_UARTE
	bool "UART-E"
endchoice

config PLATFORM_XOOM_TEGRA2
	bool
	select USE_HIGH_VECTORS
	select MACHINE_TEGRA2
```

## xen/security/Kconfig
```kconfig
menu "Security Support"
config VMM_SECURITY
	bool "Security support"
	default n

	config VMM_SECURITY_ACM
	bool  "Access control module"
	depends on VMM_SECURITY
	
		config SUBSTITUTE_IS_PRIV
		bool "Substitute IS_PRIV()"
		depends on VMM_SECURITY_ACM
		default n

	config VMM_SECURITY_SCID
	bool "Use SCID to identify VM"
	depends on VMM_SECURITY

	config VMM_SECURITY_IMAGE_VERIFICATION
	bool "Verify VM images"
	depends on VMM_SECURITY


endmenu
```
